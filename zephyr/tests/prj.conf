## CMakeLists.txt
```
# SPDX-License-Identifier: Apache-2.0

cmake_minimum_required(VERSION 3.20.0)
find_package(Zephyr REQUIRED HINTS $ENV{ZEPHYR_BASE})
project(mxml_smoke)

set(MXML_ROOT ${CMAKE_CURRENT_LIST_DIR}/../..)
set(MXML_UPSTREAM_TEST ${MXML_ROOT}/testmxml.c)
set(MXML_TEST_INCLUDE_DIR ${CMAKE_CURRENT_BINARY_DIR}/include)

include(${CMAKE_CURRENT_LIST_DIR}/../version.cmake)
if(CONFIG_POSIX_THREADS)
  set(HAVE_PTHREAD_H 1)
endif()
configure_file(
  ${CMAKE_CURRENT_LIST_DIR}/../config.h.in
  ${MXML_TEST_INCLUDE_DIR}/config.h
)

target_sources(app PRIVATE
  src/main.c
  ${MXML_UPSTREAM_TEST}
)
target_include_directories(app PRIVATE ${MXML_TEST_INCLUDE_DIR})

# Keep the upstream test source unchanged and expose its entry point to Ztest.
set_source_files_properties(
  ${MXML_UPSTREAM_TEST}
  PROPERTIES COMPILE_DEFINITIONS "main=testmxml_main"
)
```

## prj.conf
```kconfig
CONFIG_MXML=y
CONFIG_ZTEST=y
CONFIG_POSIX_API=y
CONFIG_ZTEST_STACK_SIZE=20480
CONFIG_COMMON_LIBC_MALLOC_ARENA_SIZE=16384
```

## src/main.c
```c
/* SPDX-License-Identifier: Apache-2.0 */

#include <mxml.h>
#include <zephyr/ztest.h>

extern int testmxml_main(int argc, char *argv[]);

ZTEST(mxml, test_parse_string)
{
	mxml_options_t *options = mxmlOptionsNew();
	mxml_node_t *tree;
	mxml_node_t *answer;

	zassert_not_null(options, "failed to allocate Mini-XML options");
	mxmlOptionsSetTypeValue(options, MXML_TYPE_INTEGER);

	tree = mxmlLoadString(NULL, options, "<root><answer>42</answer></root>");
	zassert_not_null(tree, "failed to parse XML");

	answer = mxmlFindPath(tree, "answer");
	zassert_not_null(answer, "failed to find parsed element");
	zassert_equal(mxmlGetInteger(answer), 42, "unexpected parsed value");

	mxmlDelete(tree);
	mxmlOptionsDelete(options);
}

ZTEST(mxml, test_upstream_suite)
{
	static char document[] =
		"<?xml version=\"1.0\"?>"
		"<root><value type=\"integer\">42</value></root>";
	char *argv[] = {
		"testmxml",
		document,
	};

	zassert_equal(testmxml_main(ARRAY_SIZE(argv), argv), 0,
		      "upstream testmxml suite failed");
}

ZTEST_SUITE(mxml, NULL, NULL, NULL, NULL, NULL);
```
