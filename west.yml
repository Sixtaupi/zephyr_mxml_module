## west.yml
```yaml
# SPDX-License-Identifier: Apache-2.0

manifest:
  self:
    path: mxml

  remotes:
    - name: zephyrproject-rtos
      url-base: https://github.com/zephyrproject-rtos

  projects:
    - name: zephyr
      remote: zephyrproject-rtos
      revision: main
      import:
        name-allowlist:
          - cmsis_6
```

## zephyr/tests/testcase.yaml
```yaml
tests:
  libraries.mxml:
    tags:
      - mxml
      - xml
    platform_allow:
      - native_sim
      - qemu_cortex_m3
```
